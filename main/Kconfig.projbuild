## main/Kconfig.projbuild
```kconfig
menu "Pin configuration"

    config DATA_PIN
        int "DATA GPIO number"
        range 0 48
        default 2

    config SCLK_PIN
        int "SCLK GPIO number"
        range 0 48
        default 16

    config BUTTON_PIN
        int "BUTTON GPIO number"
        range 0 48
        default 0

endmenu
```
